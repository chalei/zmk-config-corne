## config/boards/shields/chippy/Kconfig.shield
```kconfig
# Copyright (c) 2020 Pete Johanson
# SPDX-License-Identifier: MIT

config SHIELD_CHIPPY_LEFT
	def_bool $(shields_list_contains,chippy_left)

config SHIELD_CHIPPY_RIGHT
	def_bool $(shields_list_contains,chippy_right)

config SHIELD_CHIPPY_DONGLE
	def_bool $(shields_list_contains,chippy_dongle)
```
